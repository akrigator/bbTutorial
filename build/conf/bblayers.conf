## build/conf/bblayers.conf
```bitbake
BBPATH := "${TOPDIR}"
BSPDIR := "${@os.path.abspath(os.path.dirname(d.getVar('FILE', True)) + '/../..')}"
BBFILES ?= ""


BBLAYERS = "\
	${BSPDIR}/meta-tutorial\
"
```
